## target/configs/d13x_demo88-nor_rt-thread_helloworld_defconfig
```kconfig
CONFIG_PRJ_DEFCONFIG_FILENAME="d13x_demo88-nor_rt-thread_helloworld_defconfig"
CONFIG_PRJ_CHIP="d13x"
CONFIG_PRJ_BOARD="demo88-nor"
CONFIG_PRJ_KERNEL="rt-thread"
CONFIG_PRJ_APP="helloworld"
CONFIG_AIC_USING_FS_IMAGE_0=y
CONFIG_AIC_USING_FS_IMAGE_TYPE_FATFS_FOR_0=y
CONFIG_AIC_FS_IMAGE_DIR_0="rodata/"
CONFIG_AIC_FS_IMAGE_NAME_0="rodata.fatfs"
CONFIG_AIC_USING_FS_IMAGE_1=y
CONFIG_AIC_FS_IMAGE_DIR_1="data/"
CONFIG_AIC_FS_IMAGE_NAME_1="data.lfs"
CONFIG_AIC_FATFS_ENABLE_WRITE_IN_SPINOR=y
CONFIG_LVGL_V_9=y
CONFIG_LPKG_LVGL_THREAD_STACK_SIZE=32768
CONFIG_AIC_LVGL_DEMO=y
CONFIG_AIC_LVGL_DEMO_HUB_DEMO=y
CONFIG_LV_COLOR_DEPTH=16
CONFIG_LV_CACHE_IMG_NUM=8
CONFIG_AIC_USING_UART0=y
CONFIG_AIC_USING_I2C2=y
CONFIG_AIC_USING_CAN0=y
CONFIG_AIC_USING_QSPI0=y
CONFIG_AIC_QSPI0_DEVICE_SPINOR=y
CONFIG_AIC_QSPI0_DEVICE_SPINOR_FREQ=100000000
# CONFIG_AIC_QSPI0_DEVICE_SPINAND is not set
CONFIG_AIC_QSPI3_DEVICE_SPINAND=y
CONFIG_AIC_USING_SDMC0=y
CONFIG_AIC_USING_SDMC1=y
CONFIG_AIC_SDMC_IRQ_MODE=y

#
# SDMC0 Parameter
#
# CONFIG_AIC_SDMC0_BUSWIDTH1 is not set
CONFIG_AIC_SDMC0_BUSWIDTH4=y
# CONFIG_AIC_SDMC0_BUSWIDTH8 is not set
# CONFIG_AIC_SDMC0_DDR_MODE is not set
CONFIG_AIC_SDMC0_DRV_PHASE=3
CONFIG_AIC_SDMC0_SMP_PHASE=0
CONFIG_AIC_SDMC0_CLK_FREQ=100000000

#
# SDMC1 Parameter
#
# CONFIG_AIC_SDMC1_BUSWIDTH1 is not set
CONFIG_AIC_SDMC1_BUSWIDTH4=y
# CONFIG_AIC_SDMC1_BUSWIDTH8 is not set
# CONFIG_AIC_SDMC1_DDR_MODE is not set
CONFIG_AIC_SDMC1_DRV_PHASE=3
CONFIG_AIC_SDMC1_SMP_PHASE=0
CONFIG_AIC_SDMC1_CLK_FREQ=100000000

#
# WLAN Related:
#
CONFIG_AIC_WIRELESS_LAN=y
CONFIG_AIC_WLAN_REALTEK=y
CONFIG_AIC_USING_REALTEK_WLAN0=y
CONFIG_REALTEK_WLAN_INTF_SDIO=y
# CONFIG_REALTEK_WLAN_INTF_USB is not set
# CONFIG_AIC_USING_RTL8733_WLAN0 is not set
CONFIG_AIC_USING_RTL8189_WLAN0=y

#
# realtek wlan Parameter
#
CONFIG_AIC_DEV_REALTEK_WLAN0_PWR_GPIO="PC.7"
CONFIG_AIC_DEV_REALTEK_WLAN0_IPADDR="192.168.1.200"
CONFIG_AIC_DEV_REALTEK_WLAN0_GW="192.168.1.1"
CONFIG_AIC_DEV_REALTEK_WLAN0_NETMASK="255.255.255.0"
CONFIG_AIC_DEV_REALTEK_DEBUG=y
# CONFIG_WIFI_USING_SDIOWIFI_ATBM is not set
# CONFIG_AIC_WLAN_ASR is not set

#
# Analog Related:
#
CONFIG_AIC_USING_TSEN=y
CONFIG_AIC_USING_TSEN_CPU=y
CONFIG_AIC_USING_TSEN_GPAI=y
CONFIG_AIC_USING_GPAI=y
CONFIG_AIC_USING_GPAI7=y
CONFIG_AIC_DISP_LVDS=y
CONFIG_AICFB_RGB565=y
CONFIG_AIC_PAN_DISPLAY=y
CONFIG_AIC_STARTUP_UI_SHOW=y
CONFIG_AIC_PANEL_ENABLE_GPIO="PE.13"
CONFIG_AIC_GE_CMDQ=y
CONFIG_AIC_USING_AUDIO=y
CONFIG_AIC_AUDIO_PA_ENABLE_GPIO="PD.10"
CONFIG_AIC_AUDIO_EN_PIN_LOW=y
CONFIG_AIC_AUDIO_SPK_1=y
CONFIG_AIC_USING_DMA=y
CONFIG_AIC_USING_WRI=y
CONFIG_AIC_USING_RTC=y
CONFIG_AIC_USING_WDT=y
CONFIG_AIC_PSRAM_SW_SIZE=0x0
CONFIG_AIC_INTERRUPTSTACK_SIZE=4096
CONFIG_AIC_CLK_PLL_FRA0_FREQ=792000000
CONFIG_AIC_CLK_PLL_FRA2_FREQ=1188000000
CONFIG_AIC_USING_SID=y
CONFIG_AIC_USING_MTOP=y
CONFIG_AIC_USING_PSADC=y
CONFIG_AIC_USING_PSADC6=y
CONFIG_IDLE_THREAD_STACK_SIZE=1024
# CONFIG_RT_KSERVICE_USING_STDLIB is not set
# CONFIG_RT_DEBUG is not set
CONFIG_RT_MEMHEAP_BSET_MODE=y
CONFIG_RT_USING_MEMHEAP_AS_HEAP=y
# CONFIG_RT_USING_MEMHEAP_AUTO_BINDING is not set
CONFIG_RT_CONSOLE_DEVICE_NAME="uart0"
CONFIG_RT_MAIN_THREAD_STACK_SIZE=4096
CONFIG_FINSH_HISTORY_LINES=1
CONFIG_DFS_FILESYSTEMS_MAX=8
CONFIG_RT_USING_DFS_MNTTABLE=y
CONFIG_RT_USING_DFS_ELMFAT=y
CONFIG_RT_DFS_ELM_LFN_UNICODE_2=y
CONFIG_RT_DFS_ELM_USE_EXFAT=y
CONFIG_RT_DFS_ELM_DRIVES=4
CONFIG_RT_DFS_ELM_MAX_SECTOR_SIZE=4096
CONFIG_RT_USING_DFS_ROMFS=y
CONFIG_RT_USING_FAL=y
# CONFIG_FAL_DEBUG_CONFIG is not set
CONFIG_FAL_USING_SFUD_PORT=y
# CONFIG_FAL_BLK_DEVICE_RDONLY is not set
CONFIG_RT_USING_PWM=y
CONFIG_RT_USING_PM=y
CONFIG_PM_USING_CUSTOM_CONFIG=y
CONFIG_PM_ENABLE_SUSPEND_SLEEP_MODE=y
CONFIG_PM_ENABLE_THRESHOLD_SLEEP_MODE=y
CONFIG_RT_USING_SDIO=y
CONFIG_RT_SDIO_STACK_SIZE=4096
CONFIG_RT_SDIO_THREAD_PRIORITY=5
CONFIG_RT_MMCSD_STACK_SIZE=8192
CONFIG_RT_MMCSD_THREAD_PREORITY=22
CONFIG_RT_MMCSD_MAX_PARTITION=16
CONFIG_RT_SFUD_USING_QSPI=y
CONFIG_RT_USING_TOUCH=y
CONFIG_RT_TOUCH_PIN_IRQ=y
CONFIG_RT_USING_ULOG=y
CONFIG_ULOG_OUTPUT_LVL_I=y
CONFIG_ULOG_TIME_USING_TIMESTAMP=y
CONFIG_ULOG_USING_FILTER=y
CONFIG_LPKG_USING_CPU_USAGE=y
CONFIG_LPKG_USING_LWIP=y
CONFIG_LPKG_USING_LWIP213=y
CONFIG_LPKG_USING_LWIP_VER_NUM=0x20103
# CONFIG_LPKG_USING_LWIP_IPV6 is not set
CONFIG_LPKG_LWIP_EXAMPLES=y
CONFIG_LPKG_USING_NETTOOLS=y
# CONFIG_LPKG_LWIP_IGMP is not set
CONFIG_LPKG_LWIP_ICMP=y
# CONFIG_LPKG_LWIP_SNMP is not set
CONFIG_LPKG_LWIP_DNS=y
CONFIG_LPKG_LWIP_DHCP=y
CONFIG_LPKG_IP_SOF_BROADCAST=1
CONFIG_LPKG_IP_SOF_BROADCAST_RECV=1
CONFIG_LPKG_LWIP_UDP=y
CONFIG_LPKG_LWIP_TCP=y
CONFIG_LPKG_LWIP_RAW=y
# CONFIG_LPKG_LWIP_PPP is not set
CONFIG_LPKG_LWIP_PBUF_NUM=16
CONFIG_LPKG_LWIP_MEM_SIZE=15360
CONFIG_LPKG_LWIP_RAW_PCB_NUM=4
CONFIG_LPKG_LWIP_TCP_SEG_NUM=40
CONFIG_LPKG_LWIP_TCP_SND_BUF=8196
CONFIG_LPKG_LWIP_TCP_WND=8196
# CONFIG_LPKG_LWIP_REASSEMBLY_FRAG is not set
# CONFIG_LPKG_LWIP_STATS is not set
# CONFIG_LPKG_LWIP_USING_TX_HW_CHECKSUM is not set
# CONFIG_LPKG_LWIP_USING_RX_HW_CHECKSUM is not set
CONFIG_LPKG_MEMP_NUM_NETCONN=8
CONFIG_LPKG_LWIP_UDP_PCB_NUM=4
CONFIG_LPKG_LWIP_TCP_PCB_NUM=4
CONFIG_LPKG_LWIP_TCPTHREAD_PRIORITY=10
CONFIG_LPKG_LWIP_TCPTHREAD_MBOX_SIZE=8
CONFIG_LPKG_LWIP_TCPTHREAD_STACKSIZE=2048
CONFIG_LPKG_LWIP_USING_PING=y
CONFIG_LPKG_PING_USING_SOCKET=y
CONFIG_LPKG_PING_THREAD_PRIORITY=20
# CONFIG_LPKG_LWIP_USING_MQTT is not set
# CONFIG_LPKG_LWIP_USING_HTTP is not set
# CONFIG_LPKG_LWIP_USING_DHCPD is not set
# CONFIG_LPKG_LWIP_DEBUG is not set
# CONFIG_LPKG_USING_DFS_UFFS is not set
CONFIG_LPKG_USING_LITTLEFS=y
CONFIG_AIC_MPP_PLAYER_INTERFACE=y
CONFIG_AIC_MPP_PLAYER_VE_USE_FILL_FB=y
CONFIG_AIC_GPIO_IRQ_DRV_EN=y
CONFIG_AIC_USING_TOUCH=y
CONFIG_AIC_TOUCH_PANEL_I2C_CHAN="i2c2"
CONFIG_AIC_TOUCH_PANEL_RST_PIN="PA.10"
CONFIG_AIC_TOUCH_PANEL_INT_PIN="PA.11"
CONFIG_AIC_CMU_DRV_TEST=y
CONFIG_AIC_GPIO_DRV_TEST=y
CONFIG_AIC_DMA_DRV_TEST=y
CONFIG_AIC_CAN_DRV_TEST=y
CONFIG_AIC_AUDIO_DRV_TEST=y
CONFIG_AIC_GPAI_TEST=y
CONFIG_AIC_TSEN_TEST=y
CONFIG_AIC_PSADC_TEST=y
```
